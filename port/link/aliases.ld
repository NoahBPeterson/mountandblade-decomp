/* port/link/aliases.ld: generated by tools/port/link_tables.py from the port objects, the src/ manifests, symbols/link_inputs.json, work/relink/standalone/resolve_map.json, work/relink/standalone/mb_standalone.map (do not edit; re-run the script) */
/* src/ declares and calls these names; the MSVC link binds each to the function at the same original address
   under another name (glue.py /alternatename). PROVIDE binds only a name nothing defines.
   ABI marks a pair whose convention or argument count differs on the clang i686 build (members are cdecl
   there, `this` first on the stack): it links, but needs a thunk before that path runs. */
/* StringTable::Str::translated()  ->  PartyTemplate::translated() */
PROVIDE(_ZN11StringTable3Str10translatedEv = _ZN13PartyTemplate10translatedEv);
/* rgl::mesh::get50_()  ->  rgl::mesh::get50() */
PROVIDE(_ZN3rgl4mesh6get50_Ev = _ZN3rgl4mesh5get50Ev);
/* rgl::mesh::get70_()  ->  rgl::mesh::get70() */
PROVIDE(_ZN3rgl4mesh6get70_Ev = _ZN3rgl4mesh5get70Ev);
/* rgl::mesh::get90_()  ->  rgl::mesh::get90() */
PROVIDE(_ZN3rgl4mesh6get90_Ev = _ZN3rgl4mesh5get90Ev);
/* rgl::frustum::view_matrix()  ->  frustum_view::view_matrix() */
PROVIDE(_ZN3rgl7frustum11view_matrixEv = _ZN12frustum_view11view_matrixEv);
/* rgl::ptr_list::operator=(rgl::ptr_list const&)  ->  std::vector<int, std::allocator<int>>::operator=(std::vector<int, std::allocator<int>> const&) */
PROVIDE(_ZN3rgl8ptr_listaSERKS0_ = _ZNSt6vectorIiSaIiEEaSERKS1_);
/* convv::vector_deleting_delete(unsigned char)  ->  conv_item_array_dtor(PartyTemplate*, int, unsigned char)  ABI: cdecl/2 vs fastcall/3 */
PROVIDE(_ZN5convv22vector_deleting_deleteEh = _Z20conv_item_array_dtorP13PartyTemplateih);
/* PartyX::find_or_add(int, int, int)  ->  Party::find_or_add(unsigned int, unsigned int, char) */
PROVIDE(_ZN6PartyX11find_or_addEiii = _ZN5Party11find_or_addEjjc);
/* PartyX::sum_stat(unsigned int)  ->  Party::sum_stat(int) */
PROVIDE(_ZN6PartyX8sum_statEj = _ZN5Party8sum_statEi);
/* TroopX::set_attr(int, int)  ->  Troop::set_attr(int, int) */
PROVIDE(_ZN6TroopX8set_attrEii = _ZN5Troop8set_attrEii);
/* FaceKey::translated()  ->  PartyTemplate::translated() */
PROVIDE(_ZN7FaceKey10translatedEv = _ZN13PartyTemplate10translatedEv);
/* GameData::time_of_day()  ->  time_of_day()  ABI: cdecl/1 vs cdecl/0 */
PROVIDE(_ZN8GameData11time_of_dayEv = _Z11time_of_dayv);
/* ItemKind::translated()  ->  TroopRec::translated() */
PROVIDE(_ZN8ItemKind10translatedEv = _ZN8TroopRec10translatedEv);
/* ItemKind::find_plural()  ->  TroopRec::plural_name() */
PROVIDE(_ZN8ItemKind11find_pluralEv = _ZN8TroopRec11plural_nameEv);
/* ItemKind::display_name()  ->  TroopRec::display_name() */
PROVIDE(_ZN8ItemKind12display_nameEv = _ZN8TroopRec12display_nameEv);
/* ItemKind::translated_plural()  ->  TroopRec::translated_plural() */
PROVIDE(_ZN8ItemKind17translated_pluralEv = _ZN8TroopRec17translated_pluralEv);
/* QuestRec::set_alpha(int)  ->  Troop::set_alpha(int) */
PROVIDE(_ZN8QuestRec9set_alphaEi = _ZN5Troop9set_alphaEi);
/* item_mod::translated()  ->  PartyTemplate::translated() */
PROVIDE(_ZN8item_mod10translatedEv = _ZN13PartyTemplate10translatedEv);
/* DialogRec::translated()  ->  PartyTemplate::translated() */
PROVIDE(_ZN9DialogRec10translatedEv = _ZN13PartyTemplate10translatedEv);
/* menu_item::translated()  ->  TroopRec::translated() */
PROVIDE(_ZN9menu_item10translatedEv = _ZN8TroopRec10translatedEv);
/* std::vector<rgl::face20, std::allocator<rgl::face20>>::capacity() const  ->  std::vector<rgl::point20, std::allocator<rgl::point20>>::capacity() const */
PROVIDE(_ZNKSt6vectorIN3rgl6face20ESaIS1_EE8capacityEv = _ZNKSt6vectorIN3rgl7point20ESaIS1_EE8capacityEv);
/* std::list<shape_base*, std::allocator<shape_base*>>::_Insert(std::list<shape_base*, std::allocator<shape_base*>>::iterator, shape_base* const&)  ->  std::list<int, std::allocator<int>>::_Insert(std::list<int, std::allocator<int>>::iterator, int const&) */
PROVIDE(_ZNSt4listIP10shape_baseSaIS1_EE7_InsertENS3_8iteratorERKS1_ = _ZNSt4listIiSaIiEE7_InsertENS1_8iteratorERKi);
/* std::vector<MEdge, std::allocator<MEdge>>::clear()  ->  std::vector<rgl::entity*, std::allocator<rgl::entity*>>::_Tidy() */
PROVIDE(_ZNSt6vectorI5MEdgeSaIS0_EE5clearEv = _ZNSt6vectorIPN3rgl6entityESaIS2_EE5_TidyEv);
/* std::vector<MPoly, std::allocator<MPoly>>::clear()  ->  std::vector<rgl::entity*, std::allocator<rgl::entity*>>::_Tidy() */
PROVIDE(_ZNSt6vectorI5MPolySaIS0_EE5clearEv = _ZNSt6vectorIPN3rgl6entityESaIS2_EE5_TidyEv);
/* std::vector<MVert, std::allocator<MVert>>::clear()  ->  std::vector<rgl::entity*, std::allocator<rgl::entity*>>::_Tidy() */
PROVIDE(_ZNSt6vectorI5MVertSaIS0_EE5clearEv = _ZNSt6vectorIPN3rgl6entityESaIS2_EE5_TidyEv);
/* std::vector<shape_base*, std::allocator<shape_base*>>::resize(unsigned int, shape_base*)  ->  std::vector<rgl::Obj*, std::allocator<rgl::Obj*>>::resize(unsigned int, rgl::Obj*) */
PROVIDE(_ZNSt6vectorIP10shape_baseSaIS1_EE6resizeEjS1_ = _ZNSt6vectorIPN3rgl3ObjESaIS2_EE6resizeEjS2_);
/* std::vector<rgl::strategic_entity*, std::allocator<rgl::strategic_entity*>>::resize(unsigned int, rgl::strategic_entity*)  ->  std::vector<int, std::allocator<int>>::resize(unsigned int, int) */
PROVIDE(_ZNSt6vectorIPN3rgl16strategic_entityESaIS2_EE6resizeEjS2_ = _ZNSt6vectorIiSaIiEE6resizeEji);
/* std::vector<long long, std::allocator<long long>>::clear()  ->  std::vector<rgl::entity*, std::allocator<rgl::entity*>>::_Tidy() */
PROVIDE(_ZNSt6vectorIxSaIxEE5clearEv = _ZNSt6vectorIPN3rgl6entityESaIS2_EE5_TidyEv);
/* std::_Uninit_fill_n(rgl::idx_weight*, unsigned int, rgl::idx_weight const&, std::allocator<rgl::idx_weight>&, std::_Nonscalar_ptr_iterator_tag)  ->  void std::_Uninit_fill_n<E8*, unsigned int, E8, std::allocator<E8>>(E8*, unsigned int, E8 const&, std::allocator<E8>&, std::_Nonscalar_ptr_iterator_tag) */
PROVIDE(_ZSt14_Uninit_fill_nPN3rgl10idx_weightEjRKS0_RSaIS0_ESt27_Nonscalar_ptr_iterator_tag = _ZSt14_Uninit_fill_nIP2E8jS0_SaIS0_EEvT_T0_RKT1_RT2_St27_Nonscalar_ptr_iterator_tag);
